// SPDX-License-Identifier: (GPL-2.0+ OR MIT)
/* ASUS Tinker Edge R: NPU */
#include "rk3399pro-tinker-edge-r.dts"
#include "rk3399pro-tinker-edge-r-npu.dtsi"

/ {
	model = "ASUS Tinker Edge R (NPU)";
};
